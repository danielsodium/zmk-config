## config/west.yml
```yaml
manifest:
  remotes:
    - name: zmkfirmware
      url-base: https://github.com/zmkfirmware
    - name: danielsodium
      url-base: https://github.com/danielsodium
  projects:
    - name: zmk
      remote: zmkfirmware
      revision: main
      import: app/west.yml
    - name: nice-view-bongo-cat
      remote: danielsodium
      revision: kita
  self:
    path: config
```
